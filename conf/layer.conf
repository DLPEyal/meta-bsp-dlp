## conf/layer.conf
```bitbake
# We have a conf and classes directory, append to BBPATH
BBPATH .= ":${LAYERDIR}"

# We have a recipes directory, add to BBFILES
BBFILES += "${LAYERDIR}/recipes-*/*/*.bb \
            ${LAYERDIR}/recipes-*/*/*.bbappend"

BBFILE_COLLECTIONS += "meta-bsp-kratos"
BBFILE_PATTERN_meta-bsp-kratos := "^${LAYERDIR}/"
BBFILE_PRIORITY_meta-bsp-kratos = "5"
LAYERSERIES_COMPAT_meta-bsp-kratos = "kirkstone"

FILESEXTRAPATHS:prepend := "${LAYERDIR}/recipes-kernel/linux/files:"

CORE_IMAGE_EXTRA_INSTALL += " bridge-utils  "
CORE_IMAGE_EXTRA_INSTALL += " stress rt-tests iperf3 netperf mdiotools"
CORE_IMAGE_EXTRA_INSTALL += " openssh gdb gdbserver iptables hostname"
LINUX_KERNEL_TYPE = "preempt-rt"

CORE_IMAGE_EXTRA_INSTALL += " tcpdump netsniff-ng ethtool"
CORE_IMAGE_EXTRA_INSTALL += " systemd-ethtool maintenance loadfpga toggel-netns bit static-ip-config spidevtest jsoncpp jsoncpp-dev nano bridgeactivation kratos-station-pm-module-load lanconfig mtp-controller sram-controller armid uds2uart uds2spi"
CORE_IMAGE_EXTRA_INSTALL += " i2c-tools iproute2"
TOOLCHAIN_TARGET_TASK:append = " jsoncpp-dev"

EXTRA_OECONF += "CONFIG_DEVMEM=y"

UBOOT_CONFIG = "fspi"

#INITRAMFS_IMAGE = "core-image-minimal"
#INITRAMFS_IMAGE_BUNDLE = "1"
IMAGE_FSTYPES += "cpio.gz"
```

## conf/machine/base.conf
```bitbake
#@TYPE: Machine
#@NAME: Custom OREL i.MX 8MP Machine
#@DESCRIPTION: Consolidated machine for i.MX 8M Plus EVK with LPDDR4 and DDR4
#@MAINTAINER: Orel Eliahu <orel@example.com>

# Base SoC overrides
MACHINEOVERRIDES =. "mx8mp:"
MACHINEOVERRIDES =. "${@bb.utils.contains('IMX_DEFAULT_BOOTLOADER', 'u-boot-imx', '', 'imx-boot-container:', d)}"

# Includes
require conf/machine/include/imx-base.inc
require conf/machine/include/arm/armv8a/tune-cortexa53.inc

# Tune
DEFAULTTUNE:use-mainline-bsp = "cortexa53-crypto"

# Machine features
MACHINE_FEATURES += "pci wifi bluetooth"
MACHINE_FEATURES:append:use-nxp-bsp = " optee jailhouse mrvl8997"

# Device trees (both LPDDR4 + DDR4 support)
KERNEL_DEVICETREE_BASENAME = "imx8mp-evk"
KERNEL_DEVICETREE = " \
    freescale/${KERNEL_DEVICETREE_BASENAME}.dtb \
    freescale/base.dtb \
    freescale/decoder.dtb \
"
UBOOT_DTB_NAME = "${KERNEL_DEVICETREE_BASENAME}.dtb"

# Bootloader selection
IMX_DEFAULT_BOOTLOADER:use-nxp-bsp = "u-boot-imx"
IMX_DEFAULT_BOOTLOADER:use-mainline-bsp = "u-boot-fslc"

# U-Boot configuration
UBOOT_CONFIG_BASENAME = "imx8mp_evk"
UBOOT_SUFFIX = "bin"
UBOOT_CONFIG ??= "sd"
UBOOT_CONFIG[fspi] = "${UBOOT_CONFIG_BASENAME}_defconfig"
UBOOT_CONFIG[ndm]  = "${UBOOT_CONFIG_BASENAME}_ndm_defconfig"
UBOOT_CONFIG[sd]      = "${UBOOT_CONFIG_BASENAME}_defconfig,sdcard"
UBOOT_CONFIG[ecc]     = "${UBOOT_CONFIG_BASENAME}_inline_ecc_defconfig"
UBOOT_CONFIG[mfgtool] = "${UBOOT_CONFIG_BASENAME}_defconfig"

SPL_BINARY = "spl/u-boot-spl.bin"
UBOOT_MAKE_TARGET = "all"

# ATF
ATF_PLATFORM = "imx8mp"

# DDR Firmware
DDR_FIRMWARE_VERSION = "202006"
DDR_FIRMWARE_NAME = " \
    lpddr4_pmu_train_1d_dmem_${DDR_FIRMWARE_VERSION}.bin \
    lpddr4_pmu_train_1d_imem_${DDR_FIRMWARE_VERSION}.bin \
    lpddr4_pmu_train_2d_dmem_${DDR_FIRMWARE_VERSION}.bin \
    lpddr4_pmu_train_2d_imem_${DDR_FIRMWARE_VERSION}.bin \
"

# Boot target
IMXBOOT_TARGETS_BASENAME = "flash_evk"
IMXBOOT_TARGETS = "${@bb.utils.contains('UBOOT_CONFIG', 'fspi', '${IMXBOOT_TARGETS_BASENAME}_flexspi', '${IMXBOOT_TARGETS_BASENAME}', d)}"
IMX_BOOT_SOC_TARGET = "iMX8MP"

# Serial console
SERIAL_CONSOLES = "115200;ttymxc1"

# Syslinux settings for mainline BSP
UBOOT_EXTLINUX:use-mainline-bsp = "1"
UBOOT_EXTLINUX_LABELS:use-mainline-bsp = "default"
UBOOT_EXTLINUX_DEFAULT_LABEL:use-mainline-bsp = "i.MX8M Plus EVK"
UBOOT_EXTLINUX_MENU_DESCRIPTION:default:use-mainline-bsp = "i.MX8M Plus EVK"
UBOOT_EXTLINUX_FDT:default:use-mainline-bsp     = "../${KERNEL_DEVICETREE_BASENAME}.dtb"
UBOOT_EXTLINUX_CONSOLE:default:use-mainline-bsp = "console=${console}"
UBOOT_EXTLINUX_ROOT:default:use-mainline-bsp    = "root=/dev/mmcblk1p2"
IMAGE_BOOT_FILES:append:use-mainline-bsp = " extlinux.conf;extlinux/extlinux.conf"

# Other settings
LOADADDR = ""
IMX_BOOT_SEEK = "32"
OPTEE_BIN_EXT = "8mp"
TEE_LOAD_ADDR = "0x56000000"

# Firmware
MACHINE_FIRMWARE:append = " linux-firmware-ath10k"
```

## conf/machine/decoder.conf
```bitbake
#@TYPE: Machine
#@NAME: Custom DOREL i.MX 8MP Machine
#@DESCRIPTION: Based on imx8mp-evk with stripped DTB list

# Base overrides for i.MX8MP
MACHINEOVERRIDES =. "mx8mp:"
MACHINEOVERRIDES =. "${@bb.utils.contains('IMX_DEFAULT_BOOTLOADER', 'u-boot-imx', '', 'imx-boot-container:', d)}"

# Basic includes
require conf/machine/include/imx-base.inc
require conf/machine/include/arm/armv8a/tune-cortexa53.inc

# Tune adjustments
DEFAULTTUNE:use-mainline-bsp = "cortexa53-crypto"

# Machine features
MACHINE_FEATURES += "pci wifi bluetooth"
MACHINE_FEATURES:append:use-nxp-bsp = " optee jailhouse mrvl8997"

# ✅ Override the DTB setting – force to a single .dtb only
KERNEL_DEVICETREE := "freescale/imx8mp-evk.dtb"
UBOOT_DTB_NAME = "imx8mp-evk.dtb"

# Bootloader selection
IMX_DEFAULT_BOOTLOADER:use-nxp-bsp = "u-boot-imx"
IMX_DEFAULT_BOOTLOADER:use-mainline-bsp = "u-boot-fslc"

# U-Boot build config
UBOOT_SUFFIX = "bin"
UBOOT_CONFIG ??= "sd"
UBOOT_CONFIG[sd]      = "imx8mp_evk_defconfig,sdcard"
UBOOT_CONFIG[ecc]     = "imx8mp_evk_inline_ecc_defconfig"
UBOOT_CONFIG[mfgtool] = "imx8mp_evk_defconfig"

SPL_BINARY = "spl/u-boot-spl.bin"

# ATF Platform
ATF_PLATFORM = "imx8mp"

# IMX Boot target
IMXBOOT_TARGETS = "${@bb.utils.contains('UBOOT_CONFIG', 'fspi', '${IMXBOOT_TARGETS_BASENAME}_flexspi', '${IMXBOOT_TARGETS_BASENAME}', d)}"
IMX_BOOT_SOC_TARGET = "iMX8MP"

MACHINE_EXTRA_RRECOMMENDS:remove = "imx-mcore-demos"
MACHINE_FEATURES:remove = "m4"
EXCLUDE_FROM_WORLD:pn-imx-m7-demos = "1"
PACKAGE_EXCLUDE += "imx-m7-demos"

# Serial Console
SERIAL_CONSOLES = "115200;ttymxc1"

# Syslinux config (used in mainline boot)
UBOOT_EXTLINUX:use-mainline-bsp = "1"
UBOOT_EXTLINUX_LABELS:use-mainline-bsp = "default"
UBOOT_EXTLINUX_DEFAULT_LABEL:use-mainline-bsp = "i.MX8M Plus EVK"
UBOOT_EXTLINUX_MENU_DESCRIPTION:default:use-mainline-bsp = "i.MX8M Plus EVK"
UBOOT_EXTLINUX_FDT:default:use-mainline-bsp     = "../imx8mp-evk.dtb"
UBOOT_EXTLINUX_CONSOLE:default:use-mainline-bsp = "console=${console}"
UBOOT_EXTLINUX_ROOT:default:use-mainline-bsp    = "root=/dev/mmcblk1p2"
IMAGE_BOOT_FILES:append:use-mainline-bsp = " extlinux.conf;extlinux/extlinux.conf"

# Other settings
LOADADDR = ""
UBOOT_MAKE_TARGET = "all"
IMX_BOOT_SEEK = "32"
OPTEE_BIN_EXT = "8mp"
TEE_LOAD_ADDR = "0x56000000"

# Firmware
MACHINE_FIRMWARE:append = " linux-firmware-ath10k"
```

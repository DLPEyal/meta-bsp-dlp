## conf/distro/imx-dlp.conf
```bitbake
include conf/distro/fsl-imx-wayland.conf

DISTRO = "imx-dlp"

# Remove conflicting backends
DISTRO_FEATURES:remove = "alsa pulseaudio \
    bluetooth wifi nfc 3g \
    opengl vulkan wayland x11 \
    zeroconf \
    virtualization \
    debuginfod ptest multiarch \
    gobject-introspection-data \
    ipv6 \
    "
    
IMAGE_FEATURES:remove = "dev-pkgs dbg-pkgs tools-debug tools-profile tools-testapps"
PACKAGE_EXCLUDE += "*-dbg"
```
